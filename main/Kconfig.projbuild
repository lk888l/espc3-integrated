## main/Kconfig.projbuild
```kconfig
menu "C3 GameBox"
    menu "Board wiring (Super Mini)"
        config C3_OLED_SCLK
            int "OLED SCK GPIO"
            range 0 21
            default 4
        config C3_OLED_MOSI
            int "OLED MOSI GPIO (no MISO)"
            range 0 21
            default 6
        config C3_OLED_CS
            int "OLED CS GPIO"
            range 0 21
            default 7
        config C3_OLED_DC
            int "OLED D/C GPIO"
            range 0 21
            default 10
        config C3_OLED_RESET
            int "OLED RES GPIO"
            range 0 21
            default 5
        config C3_OLED_CLOCK_MHZ
            int "OLED SPI clock MHz"
            range 1 10
            default 8
        config C3_KEY_UP
            int "Up GPIO (-1 = disabled)"
            range -1 21
            default 0
        config C3_KEY_DOWN
            int "Down GPIO (-1 = disabled)"
            range -1 21
            default 1
        config C3_KEY_ENTER
            int "Enter GPIO (-1 = disabled)"
            range -1 21
            default 3
        config C3_KEY_BACK
            int "Exit / Back GPIO (-1 = disabled)"
            range -1 21
            default 2
            help
                Dedicated active-low exit button: connect GPIO2 to GND through
                a normally open switch. Add a 10 kohm pull-up to 3.3 V so GPIO2
                is high during reset; release the button when powering up.
                One debounced press returns one level, including in games/pets.
                GPIO2 is allowed only for this input without the global
                strapping-pin override. GPIO8/9 remain protected.
        config C3_KEY_LEFT
            int "Left GPIO (-1 = disabled)"
            range -1 21
            default -1
        config C3_KEY_RIGHT
            int "Right GPIO (-1 = disabled)"
            range -1 21
            default -1
        config C3_KEY_FUNCTION
            int "Function GPIO (-1 = disabled)"
            range -1 21
            default -1
        config C3_KEY_JUMP
            int "Jump GPIO (-1 = disabled)"
            range -1 21
            default -1
        config C3_SWD_CLK
            int "Target SWCLK GPIO"
            range 0 21
            default 20
        config C3_SWD_IO
            int "Target SWDIO GPIO"
            range 0 21
            default 21
        config C3_SWD_RESET
            int "Target NRST GPIO (-1 = not connected)"
            range -1 21
            default -1
        config C3_BUZZER_GPIO
            int "Passive buzzer PWM GPIO (-1 = silent Piano)"
            range -1 21
            default -1
            help
                Optional passive buzzer for Piano. Choose a free output GPIO;
                the board pin policy checks conflicts with display, keys and SWD.
                GPIO2/8/9 require Allow external use of strapping pins.
        config C3_ALLOW_STRAPPING_PINS
            bool "Allow external use of GPIO2/8/9 (check boot levels)"
            default n
            help
                These pins affect boot. GPIO8 also drives the onboard LED;
                GPIO9 is the BOOT button. Defaults reserve GPIO2 for the
                active-low exit button and leave GPIO8/9 unused.
    endmenu
    menu "Network"
        config C3_WIFI_SSID
            string "Initial station SSID (empty = AP only)"
            default ""
        config C3_WIFI_PASSWORD
            string "Initial station password"
            default ""
        config C3_AP_PASSWORD
            string "AP password (empty = generate and persist automatically)"
            default ""
        config C3_TIMEZONE
            string "POSIX timezone"
            default "CST-8"
        config C3_NTP_SERVER
            string "Primary SNTP server"
            default "ntp.aliyun.com"
        config C3_NTP_SERVER_BACKUP
            string "Backup SNTP server"
            default "pool.ntp.org"
    endmenu
    menu "Scheduling"
        config C3_INPUT_PERIOD_MS
            int "Button sampling period ms"
            range 1 10
            default 5
        config C3_UI_PERIOD_MS
            int "UI scheduling period ms"
            range 5 20
            default 5
    endmenu
endmenu
```

## sdkconfig.defaults
```kconfig
CONFIG_IDF_TARGET="esp32c3"
CONFIG_ESPTOOLPY_FLASHSIZE_4MB=y
CONFIG_PARTITION_TABLE_CUSTOM=y
CONFIG_PARTITION_TABLE_CUSTOM_FILENAME="partitions.csv"
CONFIG_ESP_DEFAULT_CPU_FREQ_MHZ_160=y
CONFIG_FREERTOS_HZ=1000
CONFIG_ESP_MAIN_TASK_STACK_SIZE=8192
CONFIG_ESP_CONSOLE_USB_SERIAL_JTAG=y
CONFIG_ESP_CONSOLE_SECONDARY_NONE=y
CONFIG_LOG_DEFAULT_LEVEL_INFO=y
CONFIG_LWIP_SNTP_MAX_SERVERS=2
CONFIG_LWIP_SNTP_UPDATE_DELAY=3600000
CONFIG_COMPILER_CXX_EXCEPTIONS=n
CONFIG_COMPILER_CXX_RTTI=n
CONFIG_ESP_WIFI_STA_DISCONNECTED_PM_ENABLE=n
CONFIG_ESP_WIFI_ENABLE_WPA3_SAE=y
```
